## config/west.yml
```yaml
manifest:
  remotes:
    - name: zmkfirmware
      url-base: https://github.com/zmkfirmware
    - name: petejohanson
      url-base: https://github.com/petejohanson
  projects:
    - name: zmk
      # remote: zmkfirmware
      # revision: main
      remote: petejohanson
      revision: core/peripheral-behavior-invocation
      import: app/west.yml
  self:
    path: config
```
